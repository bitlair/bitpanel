void setup() {                
  // initialize the digital pin as an output.
  // Pin 13 has an LED connected on most Arduino boards:
  pinMode(13, OUTPUT);
  pinMode(38, OUTPUT);
  pinMode(42, OUTPUT);
  pinMode(41, OUTPUT);
  pinMode(40, OUTPUT);
  pinMode(39, OUTPUT);
  
  DDRA=0xff;
  DDRC=0xff;  
}

unsigned char dispdata0[][10]=
{{0xAA,0x00,0x00,0x00,0x00, 0x40,0x00,0x00,0x00,0x00},
 {0x80,0x82,0x00,0x00,0x00, 0x40,0x00,0x00,0x40,0x00},
 {0x80,0x80,0x00,0x80,0x00, 0x40,0x00,0x00,0x00,0x00},
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 {0xAA,0x00,0x00,0x00,0x00, 0x55,0x45,0x10,0x00,0x00}};

#define DEPTH 10
#define ROWS 24
unsigned char mask=0;
void loop() {
  unsigned char x,y,z,dat;
  
  digitalWrite(40, HIGH);  //out dis
  digitalWrite(39, HIGH);   //data high
  digitalWrite(42, HIGH);  //shift
  
  
  for(y=0;y<ROWS;y++)
  {
      digitalWrite(42, HIGH);  //shift
      digitalWrite(42, LOW);
      digitalWrite(39, LOW);   //data low
      digitalWrite(40, HIGH);  //out dis
      digitalWrite(41, HIGH);  //store
      digitalWrite(41, LOW);
    
    mask=0x00;
    for (z=0;z<3;z++)
    {
    for (x=0;x<DEPTH;x++)
    {
      //PORTA=dispdata0[y][x] ^ mask;
      //PORTC=dispdata0[y][x] ^ (mask ^ 0xff);
      dat=dispdata0[y][x];
      PORTA=dat;
      PORTC=dat;
      digitalWrite(38, HIGH);   //
      digitalWrite(38, LOW);    //
//    delay(1);
    }
    //mask+=0x55;
  }
  digitalWrite(40, LOW);  //out en
  delayMicroseconds(100);
  }
}
